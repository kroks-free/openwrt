/dts-v1/;

#include "mt7628an_kroks_5eth.dtsi"

/ {
	gpio_export {
		compatible = "gpio-export";
		#size-cells = <0>;

		usb1power {
			gpio-export,name = "usb1power";
			gpio-export,output = <1>;
			gpios = <&gpio0 1 GPIO_ACTIVE_HIGH>;
		};
	};
};
